## base_external/configs/qemu_defconfig
```kconfig
BR2_aarch64=y
BR2_LINUX_KERNEL=y
BR2_LINUX_KERNEL_USE_ARCH_DEFAULT_CONFIG=y
BR2_PACKAGE_DHCPCD=y
BR2_PACKAGE_DROPBEAR=y
BR2_PACKAGE_GESFTPSERVER=y
BR2_TARGET_ROOTFS_EXT2=y
BR2_TARGET_ROOTFS_EXT2_4=y
BR2_TARGET_ROOTFS_EXT2_SIZE="240M"
BR2_PACKAGE_HOST_MKPASSWD=y
BR2_PACKAGE_APPS=y
```

## base_external/package/apps/Config.in
```kconfig
config BR2_PACKAGE_APPS
	bool "apps"
	help
	  Includes the executables, *.sh files in the kernel image.
	  Used to understand buildroot external trees and package builds.
```
